## buildroot/external/Config.in
```kconfig
source "$BR2_EXTERNAL_initramfs_extras_PATH/package/msm-fb-refresher/Config.in"
source "$BR2_EXTERNAL_initramfs_extras_PATH/package/parse-android-dynparts/Config.in"
source "$BR2_EXTERNAL_initramfs_extras_PATH/package/reboot-mode/Config.in"
```

## buildroot/external/configs/initramfs_defconfig
```kconfig
# Build
BR2_PER_PACKAGE_DIRECTORIES=y
BR2_ZCAT="pigz -d -c"

# Ccache (~/.buildroot-ccache)
# NOTE: This will make the initial build quite a bit slower, but subsequent
#       builds with no/miniscule changes should yield massive gains!
#       The directory also has to be cleared from time to time.
BR2_CCACHE=y
BR2_CCACHE_INITIAL_SETUP="--max-size=10G"
BR2_CCACHE_USE_BASEDIR=y

# static binaries
BR2_STATIC_LIBS=y

# musl libc
BR2_TOOLCHAIN_BUILDROOT_MUSL=y

# Toolchain
BR2_BINUTILS_VERSION_2_36_X=y
BR2_GCC_VERSION_10_X=y
BR2_GCC_ENABLE_LTO=y
BR2_GCC_ENABLE_GRAPHITE=y

# Target kernel headers matching lowest common denominator
@BR2_KERNEL_HEADERS@

# System
BR2_ROOTFS_SKELETON_CUSTOM=y
BR2_ROOTFS_SKELETON_CUSTOM_PATH="$(TOPDIR)/../skeleton"
BR2_ROOTFS_POST_FAKEROOT_SCRIPT="$(TOPDIR)/../br2_mkinitramfs.sh"
BR2_INIT_NONE=y

# Busybox
BR2_PACKAGE_BUSYBOX_CONFIG="$(TOPDIR)/../busybox_debug.config"

# Packages
BR2_PACKAGE_E2FSPROGS=y
# BR2_PACKAGE_E2FSPROGS_FSCK is not set
BR2_PACKAGE_E2FSPROGS_RESIZE2FS=y

# Custom external packages
BR2_PACKAGE_REBOOT_MODE=y
BR2_PACKAGE_MSM_FB_REFRESHER=y

# Filesystem images
BR2_TARGET_ROOTFS_TAR=y
BR2_TARGET_ROOTFS_TAR_GZIP=y

# Cleanup
# BR2_PACKAGE_IFUPDOWN_SCRIPTS is not set
# BR2_PACKAGE_URANDOM_SCRIPTS is not set
# BR2_ENABLE_LOCALE is not set
# NOTE: can't disable locale support on musl -> keep C locale
BR2_ENABLE_LOCALE_WHITELIST="C"
```

## buildroot/external/package/msm-fb-refresher/Config.in
```kconfig
config BR2_PACKAGE_MSM_FB_REFRESHER
	bool "msm-fb-refresher"
	help
	  Refresh /dev/fb0 60 times every second with an FBIOPAN_DISPLAY
	  ioctl; required by most if not all (Qualcomm) downstream kernels
```

## buildroot/external/package/parse-android-dynparts/Config.in
```kconfig
comment "parse-android-dynparts needs host g++ >= 5.0, and a toolchain w/ gcc >= 5.0, C++, glibc or uclibc, dynamic library, openssl, lvm2"
	depends on BR2_STATIC_LIBS || BR2_TOOLCHAIN_USES_MUSL || \
		!BR2_INSTALL_LIBSTDCPP || !BR2_HOST_GCC_AT_LEAST_5 || !BR2_TOOLCHAIN_GCC_AT_LEAST_5 || \
		!BR2_PACKAGE_OPENSSL || !BR2_PACKAGE_LIBBLOCKDEV_LVM2

config BR2_PACKAGE_PARSE_ANDROID_DYNPARTS
	bool "parse-android-dynparts"
	depends on BR2_PACKAGE_OPENSSL
	depends on BR2_PACKAGE_LIBBLOCKDEV_LVM2
	depends on BR2_INSTALL_LIBSTDCPP
	depends on BR2_HOST_GCC_AT_LEAST_5 # Full C++11
	depends on BR2_TOOLCHAIN_GCC_AT_LEAST_5 # C++11, GCC_BUG_57694
	depends on !BR2_STATIC_LIBS
	# we need libstdc++ which is not provided by musl
	depends on BR2_TOOLCHAIN_USES_GLIBC || BR2_TOOLCHAIN_USES_UCLIBC
	help
	  Allows mounting Android Dynamic Partitions (a.k.a. super.img)
	  files on Linux using "dmsetup create"
```

## buildroot/external/package/read-key/Config.in
```kconfig
config BR2_PACKAGE_READ_KEY
	bool "read-key"
	depends on BR2_TOOLCHAIN_HAS_THREADS
	help
	  Wait for any key press, print the keycode and exit

comment "read-key needs a toolchain w/ threads"
	depends on !BR2_TOOLCHAIN_HAS_THREADS
```

## buildroot/external/package/reboot-mode/Config.in
```kconfig
config BR2_PACKAGE_REBOOT_MODE
	bool "reboot-mode"
	help
	  Reboot a mobile device to a specific mode (such as recovery or
	  bootloader)
```
